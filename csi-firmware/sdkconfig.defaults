## csi-firmware/sdkconfig.defaults
```kconfig
# ESP32 CSI Positioning System Default Configuration

# Wi-Fi Configuration
CONFIG_ESP32_WIFI_ENABLED=y
CONFIG_ESP32_WIFI_SW_COEXIST_ENABLE=y
CONFIG_ESP32_WIFI_CSI_ENABLED=y
CONFIG_ESP32_WIFI_AMPDU_TX_ENABLED=y
CONFIG_ESP32_WIFI_AMPDU_RX_ENABLED=y

# Network Stack Configuration
CONFIG_LWIP_SO_REUSE=y
CONFIG_LWIP_SO_REUSE_RXTOALL=y
CONFIG_LWIP_IP_FRAG=y
CONFIG_LWIP_IP_REASSEMBLY=y

# HTTP Server Configuration
CONFIG_HTTPD_MAX_REQ_HDR_LEN=1024
CONFIG_HTTPD_MAX_URI_LEN=512

# MQTT Configuration
CONFIG_MQTT_TRANSPORT_SSL=y
CONFIG_MQTT_TRANSPORT_WEBSOCKET=y
CONFIG_MQTT_TRANSPORT_WEBSOCKET_SECURE=y

# Flash Configuration
CONFIG_PARTITION_TABLE_CUSTOM=y
CONFIG_PARTITION_TABLE_CUSTOM_FILENAME="partitions.csv"
CONFIG_PARTITION_TABLE_FILENAME="partitions.csv"

# Memory Configuration
CONFIG_ESP32_SPIRAM_SUPPORT=y
CONFIG_SPIRAM_USE_CAPS_ALLOC=y
CONFIG_SPIRAM_IGNORE_NOTFOUND=y

# Debug Configuration
CONFIG_LOG_DEFAULT_LEVEL_DEBUG=y
CONFIG_LOG_MAXIMUM_LEVEL_DEBUG=y

# FreeRTOS Configuration
CONFIG_FREERTOS_HZ=1000
CONFIG_FREERTOS_WATCHPOINT_END_OF_STACK=y

# Security Configuration
CONFIG_SECURE_BOOT_V2_ENABLED=n
CONFIG_SECURE_FLASH_ENC_ENABLED=n

# OTA Configuration
CONFIG_OTA_SKIP_COMMON_NAME_CHECK=y
CONFIG_OTA_SKIP_VERSION_CHECK=n

# NTP Configuration
CONFIG_LWIP_DHCP_GET_NTP_SRV=y
CONFIG_LWIP_SNTP_MAX_SERVERS=3

# CSI Specific Configuration
CONFIG_CSI_DATA_BITS=8
CONFIG_CSI_SUB_CARRIERS_MAX=64
CONFIG_CSI_SAMPLING_RATE=20
CONFIG_CSI_BUFFER_SIZE=1024
```

## csi-firmware/test/sdkconfig.defaults
```kconfig
# Test Configuration Defaults

# Unity Test Framework Configuration
CONFIG_UNITY_ENABLE_DOUBLE=y
CONFIG_UNITY_ENABLE_FLOAT=y
CONFIG_UNITY_ENABLE_INC_FLOAT=y
CONFIG_UNITY_ENABLE_64BIT=y

# Logging Configuration for Tests
CONFIG_LOG_DEFAULT_LEVEL_DEBUG=y
CONFIG_LOG_COLORS=y

# Memory Configuration for Tests
CONFIG_ESP32_SPIRAM_SUPPORT=y
CONFIG_SPIRAM_USE_CAPS_ALLOC=y
CONFIG_SPIRAM_IGNORE_NOTFOUND=y

# FreeRTOS Configuration for Tests
CONFIG_FREERTOS_HZ=1000
CONFIG_FREERTOS_WATCHPOINT_END_OF_STACK=y

# Disable Wi-Fi for unit tests (mock instead)
CONFIG_ESP32_WIFI_ENABLED=n

# Enable test-specific features
CONFIG_ESP_SYSTEM_ALLOW_RTC_FAST_MEM_AS_HEAP=y
```

## repos/WiFi_Tracker_Project/ESP32/main/Kconfig.projbuild
```kconfig
menu "SPIFFS partition configuration"

config SPIFFS_BASE_ADDR
    hex "SPIFFS Base address"
    range 100000 1FFE000
    default 180000
    help
	Starting address of the SPIFFS area in ESP32 Flash

config SPIFFS_SIZE
    int "SPIFFS Size in bytes"
    range 262144 2097152
    default 1048576

config SPIFFS_LOG_BLOCK_SIZE
    int "SPIFFS Logical block size"
    range 4098 65536
    default 8192

config SPIFFS_LOG_PAGE_SIZE
    int "SPIFFS Logical page size"
    range 256 2048
    default 256
    help
	Set it to the phisycal page size og the used SPI Flash chip.

endmenu

menu "Client/Server Configuration"

config WIFI_SSID
    string "WiFi SSID"
    default "myssid"
    help
	SSID (network name) for the example to connect to.

config WIFI_PASSWORD
    string "WiFi Password"
    default "mypassword"
    help
	WiFi password (WPA or WPA2) for the example to use.

config SERVER_IP
    string "Server IP"
    default "192.168.1.1"
    help
	IP of the target machine(Server) which you want to exchange data with.
	
config SERVER_PORT
    string "Server PORT"
    default "1500"
    help
	PORT of the target machine(Server) which you want to exchange data with.

config WIFI_SELECTED_CHANNEL
    string "Channel"
    default "4"
    help
	Select the channel that you want to connect with.

endmenu
```

## repos/esp32-probe-sniffer/main/Kconfig.projbuild
```kconfig
menu "Application Configuration"

config ESP32_ID
    int "ESP32 Id"
    default -1
    help
	Identification number needed to distinguish each board from the others (must be different for any board).
	
config ESP_WIFI_SSID
    string "WiFi SSID"
    default "myssid"
    help
	SSID (network name) for the example to connect to.

config ESP_WIFI_PASSWORD
    string "WiFi Password"
    default "mypassword"
    help
	WiFi password (WPA or WPA2) for the example to use.
		
config MAX_STA_CONN
    int "Max STA conn"
    default 4
    help
	Max number of the STA connects to AP.
	
config SNTP_SERVER_IP
    string "SNTP Server IP"
    default "0.0.0.0"
    help
    IP of SNTP server for time synchronization

config SERVER_ADDRESS
    string "Main server IP"
    default "0.0.0.0"
    help
        IP of main server
		
config SERVER_PORT
    string "Main server PORT"
    default "8080"
    help
        PORT of main server

endmenu
```
